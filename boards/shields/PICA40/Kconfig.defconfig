## boards/shields/PICA40/Kconfig.defconfig
```kconfig
if SHIELD_PICA40_LEFT 

config ZMK_KEYBOARD_NAME
    default "Pica 40"

config ZMK_SPLIT_ROLE_CENTRAL
    default y

endif

config INPUT_LOG_LEVEL
    int "Input driver log level"
    default 4

if SHIELD_PICA40_LEFT || SHIELD_PICA40_RIGHT

config ZMK_SPLIT
    default y

endif
```

## config/west.yml
```yaml
manifest:
  remotes:
    - name: zmkfirmware
      url-base: https://github.com/petejohanson
    - name: trentrand
      url-base: https://github.com/trentrand
  projects:
    - name: zmk
      remote: zmkfirmware
      revision: feat/pointers-move-scroll
      import: app/west.yml
    - name: zmk-pmw3610-driver
      remote: trentrand
      revision: main
  self:
    path: config
```
